## CMakeLists.txt
```
# SPDX-License-Identifier: Apache-2.0

cmake_minimum_required(VERSION 3.13.1)

# For this example, add ZEPHYR_RUST as a zephyr module. Not needed if added in
# your environment or managed by west.
get_filename_component(ZEPHYR_RUST ${CMAKE_CURRENT_SOURCE_DIR}/../.. ABSOLUTE)
list(APPEND ZEPHYR_EXTRA_MODULES ${ZEPHYR_RUST})

include($ENV{ZEPHYR_BASE}/cmake/app/boilerplate.cmake NO_POLICY_SCOPE)
project(eeprom_api)

target_sources(app PRIVATE ./src/main.c)
```

## prj.conf
```kconfig
CONFIG_ZTEST=y
CONFIG_MAIN_STACK_SIZE=2048
CONFIG_HEAP_MEM_POOL_SIZE=1024
CONFIG_EEPROM=y
CONFIG_RUST=y
```

## prj_qemu_x86.conf
```kconfig
CONFIG_ZTEST=y
CONFIG_MAIN_STACK_SIZE=2048
CONFIG_HEAP_MEM_POOL_SIZE=1024
CONFIG_EEPROM=y
CONFIG_EEPROM_SIMULATOR=y
CONFIG_RUST=y
```

## src/main.c
```c
#include <version.h>

#if KERNEL_VERSION_MAJOR < 3
#include <zephyr.h>
#else
#include <zephyr/kernel.h>
#include <zephyr/device.h>
#endif

/*
 * Export the eeprom device name for the Rust test. The sim-eeprom node moved
 * from /eeprom to /eeprom0 in Zephyr 2.7, and Zephyr 3 dropped the label
 * property from the zephyr,sim-eeprom binding, so derive the name from the
 * devicetree instead of hardcoding it.
 */
const char rust_eeprom_name[] =
#if KERNEL_VERSION_MAJOR < 3
	DT_LABEL(DT_NODELABEL(eeprom0));
#else
	DEVICE_DT_NAME(DT_NODELABEL(eeprom0));
#endif
```
