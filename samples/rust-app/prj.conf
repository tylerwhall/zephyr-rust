## prj.conf
```kconfig
CONFIG_RUST=y
CONFIG_RUST_ALLOC_POOL=y
CONFIG_SERIAL=y
CONFIG_UART_NATIVE_POSIX=y
CONFIG_NATIVE_UART_0_ON_OWN_PTY=y
CONFIG_USERSPACE=y
CONFIG_QEMU_ICOUNT=n
CONFIG_LOG=y

# CONFIG_PICOLIBC_USE_TOOLCHAIN is not set
CONFIG_PICOLIBC_USE_MODULE=y
CONFIG_STATIC_INIT_GNU=y
```

## boards/qemu_x86.conf
```kconfig
# Exercise the partial final bitmap byte on the userspace smoke-test board.
# Do not assign this option on boards without CONFIG_RUST_MUTEX_POOL.
CONFIG_RUST_MUTEX_POOL_SIZE=9
```

## src/main.c
```c
#include <zephyr.h>

#define MY_STACK_SIZE 1024
#define MY_PRIORITY 5

extern void rust_main(void);
extern void rust_second_thread(void *, void *, void *);

K_THREAD_DEFINE(my_tid, MY_STACK_SIZE,
				rust_second_thread, NULL, NULL, NULL,
				MY_PRIORITY, 0, 0);

void main(void)
{
	rust_main();
}
```
