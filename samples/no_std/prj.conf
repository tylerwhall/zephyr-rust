## CMakeLists.txt
```
# SPDX-License-Identifier: Apache-2.0

cmake_minimum_required(VERSION 3.13.1)

# For this example, add ZEPHYR_RUST as a zephyr module. Not needed if added in
# your environment or managed by west.
get_filename_component(ZEPHYR_RUST ${CMAKE_CURRENT_SOURCE_DIR}/../.. ABSOLUTE)
list(APPEND ZEPHYR_EXTRA_MODULES ${ZEPHYR_RUST})

include($ENV{ZEPHYR_BASE}/cmake/app/boilerplate.cmake NO_POLICY_SCOPE)
project(hello_world)
target_sources(app PRIVATE ./src/main.c)
```

## prj.conf
```kconfig
CONFIG_RUST=y
CONFIG_RUST_STD=n
CONFIG_RUST_ALLOC_POOL=y
CONFIG_SERIAL=y
CONFIG_UART_NATIVE_POSIX=y
CONFIG_NATIVE_UART_0_ON_OWN_PTY=y
CONFIG_USERSPACE=y
CONFIG_QEMU_ICOUNT=n
CONFIG_LOG=y
```

## src/main.c
```c
#include <version.h>
#if KERNEL_VERSION_MAJOR < 3
#include <zephyr.h>
#else
#include <zephyr/kernel.h>
#endif

#define MY_STACK_SIZE 1024
#define MY_PRIORITY 5

extern void rust_main(void);
extern void rust_second_thread(void *, void *, void *);

K_THREAD_DEFINE(my_tid, MY_STACK_SIZE,
				rust_second_thread, NULL, NULL, NULL,
				MY_PRIORITY, 0, 0);

void main(void)
{
	rust_main();
}
```
