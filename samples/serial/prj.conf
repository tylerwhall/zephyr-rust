## CMakeLists.txt
```
# SPDX-License-Identifier: Apache-2.0

cmake_minimum_required(VERSION 3.13.1)

# For this example, add ZEPHYR_RUST as a zephyr module. Not needed if added in
# your environment or managed by west.
get_filename_component(ZEPHYR_RUST ${CMAKE_CURRENT_SOURCE_DIR}/../.. ABSOLUTE)
list(APPEND ZEPHYR_EXTRA_MODULES ${ZEPHYR_RUST})

list(APPEND QEMU_EXTRA_FLAGS -serial tcp:localhost:4444,server,nowait)
include($ENV{ZEPHYR_BASE}/cmake/app/boilerplate.cmake NO_POLICY_SCOPE)
project(hello_world)
target_sources(app PRIVATE ./src/main.c)
```

## prj.conf
```kconfig
CONFIG_MAIN_STACK_SIZE=2048
CONFIG_NATIVE_UART_0_ON_OWN_PTY=y
CONFIG_RUST_ALLOC_POOL=y
CONFIG_RUST=y
CONFIG_SERIAL=y
CONFIG_UART_NATIVE_POSIX=y
CONFIG_UART_INTERRUPT_DRIVEN=y
CONFIG_USERSPACE=y
CONFIG_UART_BUFFERED=y
CONFIG_QEMU_ICOUNT=n
```

## src/main.c
```c
#include <uart_buffered.h>

extern void rust_main(struct uart_buffered_rx_handle rx,
		      struct uart_buffered_tx_handle tx);

static FIFO_DEFINE(test_uart_buffered_rx, 16);
static FIFO_DEFINE(test_uart_buffered_tx, 16);
UART_BUFFERED_DEFINE(test_uart, test_uart_buffered_rx, test_uart_buffered_tx);

void main(void)
{
	struct uart_buffered_rx_handle rx;
	struct uart_buffered_tx_handle tx;

	const struct device *uart = device_get_binding("UART_1");

	if (!uart) {
		printk("Failed to get uart\n");
		return;
	}

	UART_BUFFERED_INIT(&test_uart, uart);
#if CONFIG_USERSPACE
	uart_buffered_access_grant(&test_uart, k_current_get());
#endif
	rx = uart_buffered_rx_handle(&test_uart);
	tx = uart_buffered_tx_handle(&test_uart);

	rust_main(rx, tx);
}
```

## src/uart_buffered.h
```c
#ifndef __UART_BUFFERED_H__
#define __UART_BUFFERED_H__

#include <zephyr.h>

struct fifo {
	u16_t write;
	u16_t read;
	u8_t buf[];
};

#define FIFO_DEFINE(name, size) u8_t name[offsetof(struct fifo, buf) + size]
#define FIFO_CAPACITY(name) (sizeof(name) - offsetof(struct fifo, buf))

struct fifo_handle {
	struct fifo *fifo;
	/* capacity - 1. Capacity must be power of 2 */
	size_t capacity_mask;
	struct device *device;
	struct k_poll_signal *signal;
};

static inline size_t fifo_capacity(struct fifo_handle *fifo)
{
	return fifo->capacity_mask + 1;
}

static inline size_t fifo_used(struct fifo_handle *fifo)
{
	return fifo->fifo->write - fifo->fifo->read;
}

static inline bool fifo_full(struct fifo_handle *fifo)
{
	return fifo_used(fifo) >= fifo_capacity(fifo);
}

static inline bool fifo_empty(struct fifo_handle *fifo)
{
	return fifo_used(fifo) == 0;
}

static inline void fifo_push(struct fifo_handle *fifo, u8_t val)
{
	assert(!fifo_full(fifo));
	fifo->fifo->buf[fifo->fifo->write++ & fifo->capacity_mask] = val;
}

static inline u8_t fifo_peek(struct fifo_handle *fifo)
{
	assert(!fifo_empty(fifo));
	return fifo->fifo->buf[fifo->fifo->read & fifo->capacity_mask];
}

static inline u8_t fifo_pop(struct fifo_handle *fifo)
{
	assert(!fifo_empty(fifo));
	return fifo->fifo->buf[fifo->fifo->read++ & fifo->capacity_mask];
}

static void fifo_handle_init(struct fifo_handle *fifo, struct device *device)
{
	/* Size must be power of 2 */
	assert(fifo->capacity_mask & (fifo->capacity_mask + 1) == 0);
	fifo->device = device;
	k_poll_signal_init(fifo->signal);
}

/* Kernel memory storage for kobjects and the kernel's fifo handle */
struct uart_buffered_rx {
	struct fifo_handle fifo;
	struct k_poll_signal signal;
	struct k_timer *const timer;
};

/* Kernel memory storage for kobjects and the kernel's fifo handle */
struct uart_buffered_tx {
	struct fifo_handle fifo;
	struct k_poll_signal signal;
};

static inline struct fifo_handle *
uart_buffered_rx_handle(struct uart_buffered_rx *fifo)
{
	return &fifo->fifo;
}

static inline struct fifo_handle *
uart_buffered_tx_handle(struct uart_buffered_tx *fifo)
{
	return &fifo->fifo;
}

#define FIFO_INITIALIZER(fifo_name, signal_name)                               \
	{                                                                      \
		.fifo = (struct fifo *)&fifo_name,                             \
		.capacity_mask = FIFO_CAPACITY(fifo_name) - 1, .device = NULL, \
		.signal = signal_name,                                         \
	}

#define UART_RX_FIFO_DEFINE(name, fifo_name)                                   \
	K_TIMER_DEFINE(name##_timer, uart_buffered_rx_timeout, NULL);          \
	struct uart_buffered_rx name = {                                       \
		.fifo = FIFO_INITIALIZER(fifo_name, &name.signal),             \
		.timer = &name##_timer,                                        \
	}

#define UART_TX_FIFO_DEFINE(name, fifo_name)                                   \
	struct uart_buffered_tx name = { .fifo = FIFO_INITIALIZER(             \
						 fifo_name, &name.signal) }

/* 
 * Devices can't have user data, so this function passes the static fifo
 * pointers for this specific fifo to the generic IRQ function.
 */
#define UART_FIFO_IRQ_DEFINE(name, rx, tx)                                     \
	static void name##_irq(struct device *uart)                            \
	{                                                                      \
		uart_buffered_irq(uart, &rx, &tx);                             \
	}

#define UART_BUFFERED_DEFINE(name, rx_fifo, tx_fifo)                           \
	UART_RX_FIFO_DEFINE(name##_rx, rx_fifo);                               \
	UART_TX_FIFO_DEFINE(name##_tx, tx_fifo);                               \
	UART_FIFO_IRQ_DEFINE(name, name##_rx, name##_tx)

#define UART_BUFFERED_INIT(name, uart)                                         \
	uart_buffered_init(uart, &name##_rx, &name##_tx, name##_irq)

#endif

void uart_buffered_rx_init(struct uart_buffered_rx *fifo, struct device *uart);
```
